## iotcode/conf/layer.conf
```bitbake
# We have a conf and classes directory, add to BBPATH
BBPATH := "${BBPATH}:${LAYERDIR}"

# We have a packages directory, add to BBFILES
BBFILES := "${BBFILES} ${LAYERDIR}/*/*/*.bb \
            ${LAYERDIR}/*/*/*.bbappend"

BBFILE_COLLECTIONS += "iotcode"
BBFILE_PATTERN_iotcode = "^${LAYERDIR}/"
BBFILE_PRIORITY_iotcode = "5"
```
